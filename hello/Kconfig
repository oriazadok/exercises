## hello/Kconfig
```kconfig
config HELLO_WORLD
	tristate "Hello World kernel module"
	default n
	help
		A simple Hello World kernel module.
```

## hello_in_tree/Kconfig
```kconfig
config HELLO
	tristate "Hello world module"
	help
	  prints hello world on load and bye bye world on unload
```
